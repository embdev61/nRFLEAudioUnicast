## build/Kconfig/Kconfig.shield
```kconfig
osource "C:/ncs/v2.9.0/nrf/applications/nrf5340_audio/boards/shields/*/Kconfig.shield"
osource "C:/ncs/v2.9.0/nrf/boards/shields/*/Kconfig.shield"
```

## build/ipc_radio/Kconfig/boards/Kconfig.defconfig
```kconfig
# Load Zephyr board defconfig descriptions.
osource "C:/ncs/v2.9.0/zephyr/boards/nordic/nrf5340_audio_dk/Kconfig.defconfig"
```

## build/nrf5340_audio/Kconfig/boards/Kconfig
```kconfig
# Load Zephyr board Kconfig descriptions.
osource "C:/ncs/v2.9.0/zephyr/boards/nordic/nrf5340_audio_dk/Kconfig"
```
